## conf/machine/gb34k.conf
```bitbake
#@TYPE: Machine
#@NAME: Gigablue X3 4k
#@DESCRIPTION: Machine configuration for the Gigablue X3 4k

MACHINE_FEATURES += "mmc ci omb blindscan-dvbs blindscan-dvbc transcoding dvb-c"
OPENPLI_FEATURES += "ci"

CHIPSET = "bcm72604"

IMAGEDIR ?= "gigablue/x34k"

SRCDATE_BOLT = ""

require conf/machine/include/gigablue-gb72604.inc
```

## conf/machine/gbquad4k.conf
```bitbake
#@TYPE: Machine
#@NAME: Gigablue Quad 4k
#@DESCRIPTION: Machine configuration for the Gigablue Quad 4k

MACHINE_FEATURES += "colorlcd gigabluelcd gigabluelcd400 mmc ci omb blindscan-dvbs blindscan-dvbc transcoding streamproxy dvb-c GB-cortexa15 gb-eglfs"
OPENPLI_FEATURES += "ci kodi openhbbtvbrowser"

CHIPSET = "bcm7252s"

IMAGEDIR ?= "gigablue/quad4k"

SRCDATE_BOLT = "20181120"

require conf/machine/include/gigablue-gb7252.inc
```

## conf/machine/gbtrio4k.conf
```bitbake
#@TYPE: Machine
#@NAME: gbtrio4k
#@DESCRIPTION: Machine configuration for the gbtrio4k

EXTRA_OECONF_append_pn-enigma2 = "--with-lcddev=/dev/null --with-alphablendingacceleration=always --with-blitaccelerationthreshold=250  --with-fillaccelerationthreshold=190000"

MACHINE_FEATURES += " textlcd 7segment blindscan dvb-c hisil mali transcoding emmc"
OPENPLI_FEATURES += " qtplugins kodi"
DISTRO_FEATURES_remove = "x11 wayland"

CHIPSET = "Hi3798Mv200"

require conf/machine/include/gigablue-gbtrio4k.inc
```

## conf/machine/gbue4k.conf
```bitbake
#@TYPE: Machine
#@NAME: Gigablue UE 4k
#@DESCRIPTION: Machine configuration for the Gigablue UE 4k

MACHINE_FEATURES += "colorlcd gigabluelcd gigabluelcd220 mmc ci omb blindscan-dvbs blindscan-dvbc transcoding streamproxy dvb-c GB-cortexa15 gb-eglfs"
OPENPLI_FEATURES += "ci kodi openhbbtvbrowser"

CHIPSET = "bcm7252s"

IMAGEDIR ?= "gigablue/ue4k"

SRCDATE_BOLT = "20181120"

require conf/machine/include/gigablue-gb7252.inc
```

## conf/machine/include/gigablue-arm.inc
```bitbake
require conf/machine/include/gigablue.inc

TARGET_ARCH = "arm"
DEFAULTTUNE = "cortexa15hf-neon-vfpv4"
IMAGE_FSTYPES =+ "tar.bz2"

require conf/machine/include/tune-cortexa15.inc

DVBMEDIASINK_CONFIG = "--with-wma --with-wmv --with-amr --with-pcm --with-dts --with-eac3 --with-h265 --with-vb6 --with-vb8 --with-vb9 --with-spark \
"

PREFERRED_PROVIDER_virtual/blindscan-dvbc = "gigablue-blindscan-utils-arm"
PREFERRED_PROVIDER_virtual/blindscan-dvbs = "gigablue-blindscan-utils-arm"

require conf/machine/include/soc-family.inc
```

## conf/machine/include/gigablue-gb7252.inc
```bitbake
require conf/machine/include/gigablue-arm.inc

MACHINE_KERNEL_PR = "r7"

MACHINE_EXTRA_RRECOMMENDS = " \
    gst-plugin-dvbmediasink \
    ntfs-3g \
"

PREFERRED_VERSION_linux-gigablue = "4.1.20"
PREFERRED_PROVIDER_virtual/kernel = "linux-gigablue"
PREFERRED_PROVIDER_virtual/egl = "gb-v3ddriver-gb7252"
PREFERRED_PROVIDER_virtual/libgles2 = "gb-v3ddriver-gb7252"

PACKAGECONFIG_GL_pn-qtbase = " gles2 eglfs linuxfb"

IMGDEPLOYDIR ?= "${DEPLOY_DIR_IMAGE}"

IMAGE_CMD_tar_prepend = "\
    mkdir -p ${IMGDEPLOYDIR}/${IMAGEDIR}; \
    cp ${DEPLOY_DIR_IMAGE}/${MACHINE}_boot.bin ${IMGDEPLOYDIR}/${IMAGEDIR}/boot.bin; \
    cp ${DEPLOY_DIR_IMAGE}/${MACHINE}_gpt.bin ${IMGDEPLOYDIR}/${IMAGEDIR}/gpt.bin; \
    cp ${DEPLOY_DIR_IMAGE}/${MACHINE}_rescue.bin ${IMGDEPLOYDIR}/${IMAGEDIR}/rescue.bin; \
    cp ${DEPLOY_DIR_IMAGE}/${MACHINE}_bolt_${SRCDATE_BOLT}.bin ${IMGDEPLOYDIR}/${IMAGEDIR}/bolt_${SRCDATE_BOLT}.bin; \
    cp ${DEPLOY_DIR_IMAGE}/zImage ${IMGDEPLOYDIR}/${IMAGEDIR}/kernel.bin; \
    echo ${DISTRO_NAME}-${DISTRO_VERSION}.${BUILD_VERSION} > ${IMGDEPLOYDIR}/${IMAGEDIR}/imageversion; \
    cd ${IMAGE_ROOTFS}; \
    tar -cvf ${IMGDEPLOYDIR}/rootfs.tar -C ${IMAGE_ROOTFS} .; \
    mv ${IMGDEPLOYDIR}/rootfs.tar ${IMGDEPLOYDIR}/${IMAGEDIR}/rootfs.tar; \
    bzip2 ${IMGDEPLOYDIR}/${IMAGEDIR}/rootfs.tar; \
    cd ${IMGDEPLOYDIR}; \
    zip ${IMAGE_NAME}_usb.zip ${IMAGEDIR}/*; \
    rm -Rf gigablue; \
"

MACHINE_ESSENTIAL_EXTRA_RDEPENDS = " \
    gigablue-platform-util-gb7252 \
    gigablue-ddbootup \
    gigablue-swapcreate \
"

MACHINE_ESSENTIAL_EXTRA_RRECOMMENDS = " \
    gb-v3ddriver-gb7252 \
    gb-qteglfs-platform \
    "

EXTRA_IMAGEDEPENDS = "\
    gigablue-initrd-cfe-${MACHINE} \
    "

IMAGE_INSTALL_append += "\
    bluetoothsetup-gb7252 \
    "

OPTIONAL_BSP_ENIGMA2_PACKAGES = "\
    enigma2-plugin-extensions-hbbtv-gb \
    enigma2-plugin-extensions-chromium \
    "
```

## conf/machine/include/gigablue.inc
```bitbake
KERNEL_MODULE_AUTOLOAD += "xfs"

# We know about rtc
MACHINE_FEATURES_BACKFILL_CONSIDERED = "rtc"

IMAGEVERSION := "${DISTRO_NAME}-${DISTRO_VERSION}-${DATE}"
IMAGEVERSION[vardepsexclude] = "DATE"

MACHINE_FEATURES += "3dtv alsa hdmicec switchoff"
```
